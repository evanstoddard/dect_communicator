## CMakeLists.txt
```
#-------------------------------------------------------------------------------
# Zephyr Example Application
#
# Copyright (c) 2021 Nordic Semiconductor ASA
# SPDX-License-Identifier: Apache-2.0

cmake_minimum_required(VERSION 3.13.1)
find_package(Zephyr REQUIRED HINTS $ENV{ZEPHYR_BASE})

set(CMAKE_EXPORT_COMPILE_COMMANDS ON)

project(app LANGUAGES C)

target_sources(app PRIVATE 
    src/main.c
)

add_subdirectory(src)
```

## prj.conf
```kconfig
# Copyright (c) 2021 Nordic Semiconductor ASA
# SPDX-License-Identifier: Apache-2.0
#
# This file contains selected Kconfig options for the application.

# Modem
CONFIG_NRF_MODEM_LIB=y
CONFIG_MODEM_ANTENNA=n

# DECT NR+
CONFIG_NRF_MODEM_LINK_BINARY_DECT_PHY=y

# NOTE: This is for US only
CONFIG_CARRIER=1711 
CONFIG_TX_POWER=10

# Hardware Info
CONFIG_HWINFO=y
CONFIG_HWINFO_NRF=y

# Logging
CONFIG_LOG=y
CONFIG_PRINTK=y
CONFIG_ASSERT=y

# Shell
CONFIG_SHELL=y

# Network Buffer Support
CONFIG_NET_BUF=y

# Entropy
CONFIG_ENTROPY_GENERATOR=y
CONFIG_ENTROPY_DEVICE_RANDOM_GENERATOR=y

# Silence TF-M logging — UART1 is shared with HCI H4 to the nRF5340
CONFIG_TFM_LOG_LEVEL_SILENCE=y

# Bluetooth Host (external controller on nRF5340 via HCI H4 over UART1)
CONFIG_BT=y
CONFIG_BT_H4=y
CONFIG_BT_PERIPHERAL=y
CONFIG_BT_DEVICE_NAME="DECT Communicator"
CONFIG_BT_L2CAP_TX_MTU=251
CONFIG_BT_BUF_ACL_RX_SIZE=255
CONFIG_BT_BUF_ACL_TX_SIZE=255
CONFIG_UART_INTERRUPT_DRIVEN=y
```

## boards/dectcomm_nrf9151_ns.overlay
```dts
/* SPDX-License-Identifier: Apache-2.0 */

/ {
	chosen {
		/* BLE host uses external controller on nRF5340 via HCI H4 over UART1 */
		zephyr,bt-hci = &bt_hci_uart;
	};
};

&uart1 {
	status = "okay";

	bt_hci_uart: bt_hci_uart {
		compatible = "zephyr,bt-hci-uart";
		status = "okay";
	};
};
```

## src/main.c
```c
/*
 * Copyright (C) Evan Stoddard
 */

/**
 * @file main.c
 * @brief
 */

#include <zephyr/kernel.h>
#include <zephyr/logging/log.h>

#include "dect/dect_data_layer.h"

#include "ble/ble_core.h"

LOG_MODULE_REGISTER(main, LOG_LEVEL_DBG);

/*****************************************************************************
 * Definitions
 *****************************************************************************/

/*****************************************************************************
 * Variables
 *****************************************************************************/

/*****************************************************************************
 * Prototypes
 *****************************************************************************/

/*****************************************************************************
 * Functions
 *****************************************************************************/

int main(void)
{
    LOG_INF("Application started.");

    return 0;
}
```
