## CMakeLists.txt
```
#-------------------------------------------------------------------------------
# Zephyr Example Application
#
# Copyright (c) 2021 Nordic Semiconductor ASA
# SPDX-License-Identifier: Apache-2.0

cmake_minimum_required(VERSION 3.13.1)
find_package(Zephyr REQUIRED HINTS $ENV{ZEPHYR_BASE})

project(app LANGUAGES C)

target_sources(app PRIVATE 
    src/main.c
)

add_subdirectory(src)
```

## Kconfig
```
# Copyright (c) 2021 Nordic Semiconductor ASA
# SPDX-License-Identifier: Apache-2.0
#
# This file is the application Kconfig entry point. All application Kconfig
# options can be defined here or included via other application Kconfig files.
# You can browse these options using the west targets menuconfig (terminal) or
# guiconfig (GUI).

menu "Zephyr"
source "Kconfig.zephyr"

config CARRIER
	int "Carrier to use"
	default 0
	help
	   The availability of the channels and the exact regulation to use them varies in different countries.
	   See ETSI TS 103 636-2 5.4.2 for the calculation.
	   Band index 1 is set when the carrier is within the range of 525 to 551.
	   This is the only range allowed for band index 1 as other carriers will interfere with other radio devices, including LTE devices.

config NETWORK_ID
	int "Network ID"
	range 1 4294967295
	default 91

config MCS
	int "MCS"
	default 1
	help
	   The MCS impacts how much data can fit into each subslot.

config TX_POWER
	int "TX power"
	range 0 13
	default 13
	help
	   Transmission power, max 19 dBm due to hardware limitations.
	   See table 6.2.1-3 of ETSI TS 103 636-4 v1.5.1.

endmenu

module = APP
module-str = APP
```

## prj.conf
```kconfig
# Copyright (c) 2021 Nordic Semiconductor ASA
# SPDX-License-Identifier: Apache-2.0
#
# This file contains selected Kconfig options for the application.

# Modem
CONFIG_NRF_MODEM_LIB=y
CONFIG_MODEM_ANTENNA=n

# DECT NR+
CONFIG_NRF_MODEM_LINK_BINARY_DECT_PHY=y

# NOTE: This is for US only
CONFIG_CARRIER=1711 
CONFIG_TX_POWER=10

# Hardware Info
CONFIG_HWINFO=y
CONFIG_HWINFO_NRF=y

# Logging
CONFIG_LOG=y
CONFIG_PRINTK=y
CONFIG_ASSERT=y

# Shell
CONFIG_SHELL=y

# Network Buffer Support
CONFIG_NET_BUF=y

# Entropy
CONFIG_ENTROPY_GENERATOR=y
CONFIG_ENTROPY_DEVICE_RANDOM_GENERATOR=y
```

## src/main.c
```c
/*
 * Copyright (C) Evan Stoddard
 */

/**
 * @file main.c
 * @brief
 */

#include <zephyr/kernel.h>
#include <zephyr/logging/log.h>

#include "dect/dect_data_layer.h"
#include "dect/dect_protocol_layer.h"

LOG_MODULE_REGISTER(main, LOG_LEVEL_DBG);

/*****************************************************************************
 * Definitions
 *****************************************************************************/

/*****************************************************************************
 * Variables
 *****************************************************************************/

/*****************************************************************************
 * Prototypes
 *****************************************************************************/

/*****************************************************************************
 * Functions
 *****************************************************************************/

int main(void)
{
    LOG_INF("Application started.");

    int ret = dect_data_layer_init();

    if (ret != 0) {
        LOG_ERR("Failed to initialize DECT data layer: %d", ret);
        return ret;
    }
    LOG_INF("DECT Data Layer Initialized!");

    ret = dect_protocol_layer_init();
    if (ret != 0) {
        LOG_ERR("Failed to initialize DECT protocol layer: %d", ret);
        return ret;
    }

    LOG_INF("DECT Protocol Layer Initialized!");

    return 0;
}
```
