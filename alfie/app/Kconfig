## alfie/app/Kconfig
```kconfig
# Copyright (c) 2021 Nordic Semiconductor ASA
# SPDX-License-Identifier: Apache-2.0
#
# This file is the application Kconfig entry point. All application Kconfig
# options can be defined here or included via other application Kconfig files.
# You can browse these options using the west targets menuconfig (terminal) or
# guiconfig (GUI).

menu "Zephyr"
source "Kconfig.zephyr"

config CARRIER
	int "Carrier to use"
	default 0
	help
	   The availability of the channels and the exact regulation to use them varies in different countries.
	   See ETSI TS 103 636-2 5.4.2 for the calculation.
	   Band index 1 is set when the carrier is within the range of 525 to 551.
	   This is the only range allowed for band index 1 as other carriers will interfere with other radio devices, including LTE devices.

config NETWORK_ID
	int "Network ID"
	range 1 4294967295
	default 91

config MCS
	int "MCS"
	default 1
	help
	   The MCS impacts how much data can fit into each subslot.

config TX_POWER
	int "TX power"
	range 0 13
	default 13
	help
	   Transmission power, max 19 dBm due to hardware limitations.
	   See table 6.2.1-3 of ETSI TS 103 636-4 v1.5.1.

config DECT_PROTO_MAX_REASSEM_CONTEXTS 
	int "Number of reassembly contexts."
	range 1 64
	default 4
	help
		Defines the maximum number of reassmbly contexts supported in the data layer.
		This directly impacts the number of concurrent messages the device can receive.

config DECT_PROTO_MAX_FRAGMENTS_PER_CONTEXT
	int "Max context fragments."
	range 4 64
	default 32
	help
		Maximum fragments that can be reassembled for sequence ID.

config DECT_PROTO_MAX_FRAGMENT_SIZE_BYTES
	int "Max size of fragment."
	default 16
	help
		Maximum size of a protocol layer fragment

endmenu

module = APP
module-str = APP
```

## alfie/ble_bridge/Kconfig
```kconfig
# Copyright (c) 2024 Nordic Semiconductor ASA
# SPDX-License-Identifier: Apache-2.0

menu "Zephyr"
source "Kconfig.zephyr"
endmenu
```

## alfie/boards/custom/dectcomm/Kconfig
```kconfig
# Copyright (c) 2024 Nordic Semiconductor
# SPDX-License-Identifier: LicenseRef-Nordic-5-Clause

module=BOARD
module-dep=LOG
module-str=Log level for board
source "${ZEPHYR_BASE}/subsys/logging/Kconfig.template.log_config"

if BOARD_DECTCOMM_NRF5340_CPUAPP || BOARD_DECTCOMM_NRF5340_CPUAPP_NS

config BOARD_ENABLE_DCDC_APP
	bool "Application MCU DCDC converter"
	default y

config BOARD_ENABLE_DCDC_NET
	bool "Network MCU DCDC converter"
	default y

config DOMAIN_CPUNET_BOARD
	string
	default "dectcomm/nrf5340/cpunet"
	depends on SOC_NRF53_CPUNET_ENABLE
	help
	  The board which will be used for CPUNET domain when creating a multi
	  image application where one or more images should be located on
	  another board. For example hci_rpmsg on the nRF5340_cpunet for
	  Bluetooth applications.

endif

if BOARD_DECTCOMM_NRF5340_CPUNET

config BT_ECC
	default y if BT

config DOMAIN_CPUAPP_BOARD
	string
	default "dectcomm/nrf5340/cpuapp"
	help
	  The board which will be used for CPUAPP domain when creating a multi
	  image application where one or more images should be located on
	  another board.

endif # BOARD_DECTCOMM_NRF5340_CPUNET
```

## alfie/boards/custom/dectcomm/Kconfig.dectcomm
```kconfig
# Copyright (c) 2024 Nordic Semiconductor
# SPDX-License-Identifier: LicenseRef-Nordic-5-Clause

config BOARD_DECTCOMM
	select SOC_NRF9151_LACA if BOARD_DECTCOMM_NRF9151 || BOARD_DECTCOMM_NRF9151_NS
	select SOC_NRF5340_CPUNET_QKAA if BOARD_DECTCOMM_NRF5340_CPUNET
	select SOC_NRF5340_CPUAPP_QKAA if BOARD_DECTCOMM_NRF5340_CPUAPP || BOARD_DECTCOMM_NRF5340_CPUAPP_NS
```

## communicator/boards/custom/dectcomm/board.yml
```yaml
board:
  name: dectcomm
  vendor: custom
  socs:
    - name: nrf9151
      variants:
        - name: ns
    - name: nrf5340
      variants:
        - name: ns
          cpucluster: 'cpuapp'
```

## project/west.yml
```yaml
# Copyright (c) 2021 Nordic Semiconductor ASA
# SPDX-License-Identifier: Apache-2.0

manifest:
  self:
    west-commands: scripts/west-commands.yml

  remotes:
    - name: ncs
      url-base: https://github.com/nrfconnect
    - name: ovyl
      url-base: https://github.com/Ovyl

  projects:
    - name: nrf
      remote: ncs
      repo-path: sdk-nrf
      revision: v3.1.1
      import: true

    - name: ovyl-zephyr-modules
      remote: ovyl
      repo-path: ovyl-zephyr-modules
      revision: main
      path: modules/ovyl
```
